#include <behaviors/mouse_key_press.dtsi>
#include <dt-bindings/zmk/mouse.h>
#include <behaviors.dtsi>
#include <behaviors/unicode.dtsi> // Requires zmk-unicode module.
#include <dt-bindings/zmk/bt.h>
#include <dt-bindings/zmk/ext_power.h>
#include <dt-bindings/zmk/keys.h>
#include <dt-bindings/zmk/outputs.h>
#include <dt-bindings/zmk/pointing.h>
#include <dt-bindings/zmk/rgb.h>

#include "zmk-helpers/helper.h"

/* zmk-helpers: key labels for 42-key layout (Corne). */
#include "zmk-helpers/key-labels/42.h"

#define QUICK_TAP_MS 175

/* Layer definitions for combos */
#define DEF 0  // BASE layer
#define EXTRA 1  // EXTRA layer
#define TAP 2  // TAP layer

/* Key position groups */
#define KEYS_L LT0 LT1 LT2 LT3 LT4 LT5 LM0 LM1 LM2 LM3 LM4 LM5 LB0 LB1 LB2 LB3 LB4 LB5
#define KEYS_R RT0 RT1 RT2 RT3 RT4 RT5 RM0 RM1 RM2 RM3 RM4 RM5 RB0 RB1 RB2 RB3 RB4 RB5
#define THUMBS LH2 LH1 LH0 RH0 RH1 RH2

/* HRM helper macro */
#define MAKE_HRM(NAME, HOLD, TAP, TRIGGER_POS) \
  ZMK_HOLD_TAP(NAME, \
    bindings = <HOLD>, <TAP>; \
    flavor = "balanced"; \
    tapping-term-ms = <280>; \
    quick-tap-ms = <QUICK_TAP_MS>; \
    require-prior-idle-ms = <150>; \
    hold-trigger-key-positions = <TRIGGER_POS>; \
    hold-trigger-on-release; \
  )



/* Left-hand and Right-hand HRMs */
MAKE_HRM(hml, &kp, &kp, KEYS_R THUMBS) // Left-hand HRMs.
MAKE_HRM(hmr, &kp, &kp, KEYS_L THUMBS) // Right-hand HRMs.

/* 8-argument combo for HRM combos */
// Hack: Make HRM combos tap-only (cf, ZMK issue #544).
#define ZMK_COMBO_8(NAME, TAP, POS, LAYERS, COMBO_MS, IDLE_MS, HOLD, SIDE) \
  MAKE_HRM(hm_combo_##NAME, &kp, TAP, SIDE THUMBS) \
  ZMK_COMBO_6(NAME, &hm_combo_##NAME HOLD 0, POS, LAYERS, COMBO_MS, IDLE_MS)


// Sticky shift + leader.
ZMK_MACRO(leader_sft, bindings = <&sk LSHFT &leader>;)

#include "combos.dtsi" // Must be sourced after HRM-combo hack
#include "leader.dtsi"

/* Keymap */

#define XXX &none
#define ___ &trans

#ifndef ZMK_BASE_LAYER
  #define ZMK_BASE_LAYER(name, LT, RT, LM, RM, LB, RB, LH, RH) \
      ZMK_LAYER(name, LT RT LM RM LB RB LH RH)
#endif

ZMK_BASE_LAYER(Base,
//╭──────────┬──────────┬──────────┬──────────┬──────────┬──────────╮ ╭──────────┬──────────┬──────────┬──────────┬──────────┬──────────╮
    &kp TAB    &kp Q      &kp W      &kp E      &kp R      &kp T    ,   &kp Y      &kp U      &kp I      &kp O      &kp P      &kp BSPC ,
//├──────────┼──────────┼──────────┼──────────┼──────────┼──────────┤ ├──────────┼──────────┼──────────┼──────────┼──────────┼──────────┤
    &kp ESC    &hml LALT A &hml LGUI S &hml LCTRL D &hml LSHFT F &kp G ,   &kp H      &hmr LSHFT J &hmr LCTRL K &hmr LGUI L &hmr LALT SEMI &kp SQT ,
//├──────────┼──────────┼──────────┼──────────┼──────────┼──────────┤ ├──────────┼──────────┼──────────┼──────────┼──────────┼──────────┤
    &kp LSHFT  &u_lt 3 Z  &u_mt RALT X &kp C      &kp V      &kp B    ,   &kp N      &kp M      &kp COMMA  &u_mt RALT PERIOD &u_lt 3 SLASH &kp RET ,
//╰──────────┴──────────┴──────────┼──────────┼──────────┼──────────┤ ├──────────┼──────────┼──────────┼──────────┴──────────┴──────────╯
                                     &u_lt 6 ESC &u_lt 4 SPACE &u_lt 5 TAB , &u_lt 8 RET &u_lt 7 BSPC &u_lt 9 DEL
//                                 ╰──────────┴──────────┴──────────╯ ╰──────────┴──────────┴──────────╯
)

ZMK_BASE_LAYER(Extra,
//╭──────────┬──────────┬──────────┬──────────┬──────────┬──────────╮ ╭──────────┬──────────┬──────────┬──────────┬──────────┬──────────╮
    &kp TAB    &kp Q      &kp W      &kp B      &kp F      &kp G    ,   &kp Y      &kp U      &kp K      &kp L      &kp SEMI      &kp BSPC ,
//├──────────┼──────────┼──────────┼──────────┼──────────┼──────────┤ ├──────────┼──────────┼──────────┼──────────┼──────────┼──────────┤
    &kp ESC    &hml LALT A &hml LGUI S &hml LCTRL D &hml LSHFT R &kp T ,   &kp H      &hmr LSHFT N &hmr LCTRL I &hmr LGUI O &hmr LALT P &kp SQT ,
//├──────────┼──────────┼──────────┼──────────┼──────────┼──────────┤ ├──────────┼──────────┼──────────┼──────────┼──────────┼──────────┤
    &kp LSHFT  &u_lt 3 Z  &u_mt RALT X &kp C      &kp V   &kp MINUS    ,   &kp J      &kp M      &kp COMMA  &u_mt RALT PERIOD &u_lt 3 SLASH &kp RET ,
//╰──────────┴──────────┴──────────┼──────────┼──────────┼──────────┤ ├──────────┼──────────┼──────────┼──────────┴──────────┴──────────╯
                                     &u_lt 6 ESC &u_lt 4 SPACE &u_lt 5 TAB , &u_lt 8 RET &u_lt 7 E &u_lt 9 BSPC
//                                 ╰──────────┴──────────┴──────────╯ ╰──────────┴──────────┴──────────╯
)

ZMK_BASE_LAYER(Tap,
//╭──────────┬──────────┬──────────┬──────────┬──────────┬──────────╮ ╭──────────┬──────────┬──────────┬──────────┬──────────┬──────────╮
    &kp TAB    &kp Q      &kp W      &kp E      &kp R      &kp T    ,   &kp Y      &kp U      &kp I      &kp O      &kp P      &kp BSPC ,
//├──────────┼──────────┼──────────┼──────────┼──────────┼──────────┤ ├──────────┼──────────┼──────────┼──────────┼──────────┼──────────┤
    &kp ESC    &kp A      &kp S      &kp D      &kp F      &kp G    ,   &kp H      &kp J      &kp K      &kp L      &kp SEMI   &kp SQT  ,
//├──────────┼──────────┼──────────┼──────────┼──────────┼──────────┤ ├──────────┼──────────┼──────────┼──────────┼──────────┼──────────┤
    &kp LSHFT  &kp Z      &kp X      &kp C      &kp V      &kp B    ,   &kp N      &kp M      &kp COMMA  &kp DOT    &kp FSLH   XXX      ,
//╰──────────┴──────────┴──────────┼──────────┼──────────┼──────────┤ ├──────────┼──────────┼──────────┼──────────┴──────────┴──────────╯
                                     &kp ESC    &kp SPACE  &kp TAB  ,   &kp RET    &kp BSPC   &kp DEL
//                                 ╰──────────┴──────────┴──────────╯ ╰──────────┴──────────┴──────────╯
)

ZMK_BASE_LAYER(Button,
//╭──────────┬──────────┬──────────┬──────────┬──────────┬──────────╮ ╭──────────┬──────────┬──────────┬──────────┬──────────┬──────────╮
    XXX        &kp K_UNDO &kp LS(DEL) &kp LC(INS) &kp LS(INS) &kp K_AGAIN , &kp K_AGAIN &kp LS(INS) &kp LC(INS) &kp LS(DEL) &kp K_UNDO XXX      ,
//├──────────┼──────────┼──────────┼──────────┼──────────┼──────────┤ ├──────────┼──────────┼──────────┼──────────┼──────────┼──────────┤
    XXX        &kp LALT   &kp LGUI   &kp LCTRL  &kp LSHFT  XXX      ,   XXX        &kp LSHFT  &kp LCTRL  &kp LGUI   &kp LALT   XXX      ,
//├──────────┼──────────┼──────────┼──────────┼──────────┼──────────┤ ├──────────┼──────────┼──────────┼──────────┼──────────┼──────────┤
    XXX        &kp K_UNDO &kp LS(DEL) &kp LC(INS) &kp LS(INS) &kp K_AGAIN , &kp K_AGAIN &kp LS(INS) &kp LC(INS) &kp LS(DEL) &kp K_UNDO XXX      ,
//╰──────────┴──────────┴──────────┼──────────┼──────────┼──────────┤ ├──────────┼──────────┼──────────┼──────────┴──────────┴──────────╯
                                     &mkp MB3   &mkp MB1   &mkp MB2 ,   &mkp MB2   &mkp MB1   &mkp MB3
//                                 ╰──────────┴──────────┴──────────╯ ╰──────────┴──────────┴──────────╯
)

ZMK_BASE_LAYER(Nav,
//╭──────────┬──────────┬──────────┬──────────┬──────────┬──────────╮ ╭──────────┬──────────┬──────────┬──────────┬──────────┬──────────╮
    XXX        &bootloader &u_to_U_TAP &u_to_U_EXTRA &u_to_U_BASE XXX  ,   &kp K_AGAIN &kp LS(INS) &kp LC(INS) &kp LS(DEL) &kp K_UNDO XXX      ,
//├──────────┼──────────┼──────────┼──────────┼──────────┼──────────┤ ├──────────┼──────────┼──────────┼──────────┼──────────┼──────────┤
    XXX        &kp LALT   &kp LGUI   &kp LCTRL  &kp LSHFT  XXX      ,   &kp LEFT   &kp DOWN   &kp UP     &kp RIGHT  &u_caps_word XXX    ,
//├──────────┼──────────┼──────────┼──────────┼──────────┼──────────┤ ├──────────┼──────────┼──────────┼──────────┼──────────┼──────────┤
    XXX        XXX        &kp RALT   &u_to_U_NUM &u_to_U_NAV XXX    ,   &kp HOME   &kp PG_DN  &kp PG_UP  &kp END    &kp INS    XXX      ,
//╰──────────┴──────────┴──────────┼──────────┼──────────┼──────────┤ ├──────────┼──────────┼──────────┼──────────┴──────────┴──────────╯
                                     XXX        XXX        XXX      ,   &kp RET    &kp BSPC   &kp DEL
//                                 ╰──────────┴──────────┴──────────╯ ╰──────────┴──────────┴──────────╯
)

ZMK_BASE_LAYER(RowNum,
//╭──────────┬──────────┬──────────┬──────────┬──────────┬──────────╮ ╭──────────┬──────────┬──────────┬──────────┬──────────┬──────────╮
    &kp GRAVE  &kp N1     &kp N2     &kp N3     &kp N4     &kp N5   ,   &kp N6     &kp N7     &kp N8     &kp N9     &kp N0     &kp MINUS,
//├──────────┼──────────┼──────────┼──────────┼──────────┼──────────┤ ├──────────┼──────────┼──────────┼──────────┼──────────┼──────────┤
    XXX        &kp LALT   &kp LGUI   &kp LCTRL  &kp LSHFT  XXX      ,   XXX        &kp N4     &kp N5     &kp N6     &kp KP_N6  XXX      ,
//├──────────┼──────────┼──────────┼──────────┼──────────┼──────────┤ ├──────────┼──────────┼──────────┼──────────┼──────────┼──────────┤
    XXX        XXX        &kp RALT   &u_to_U_SYM &u_to_U_MOUSE XXX  ,   XXX        &kp N1     &kp N2     &kp N3     XXX        XXX      ,
//╰──────────┴──────────┴──────────┼──────────┼──────────┼──────────┤ ├──────────┼──────────┼──────────┼──────────┴──────────┴──────────╯
                                     XXX        XXX        XXX      ,   &kp MINUS  &kp N0     &kp DOT
//                                 ╰──────────┴──────────┴──────────╯ ╰──────────┴──────────┴──────────╯
)

ZMK_BASE_LAYER(Media,
//╭──────────┬──────────┬──────────┬──────────┬──────────┬──────────╮ ╭──────────┬──────────┬──────────┬──────────┬──────────┬──────────╮
    XXX        &bootloader &u_to_U_TAP &u_to_U_EXTRA &u_to_U_BASE XXX ,   &rgb_ug RGB_TOG &rgb_ug RGB_EFF &rgb_ug RGB_HUI &rgb_ug RGB_SAI &rgb_ug RGB_BRI XXX ,
//├──────────┼──────────┼──────────┼──────────┼──────────┼──────────┤ ├──────────┼──────────┼──────────┼──────────┼──────────┼──────────┤
    XXX        &kp LALT   &kp LGUI   &kp LCTRL  &kp LSHFT  XXX      ,   &ext_power EP_TOG &kp C_PREV &kp C_VOL_DN &kp C_VOL_UP &kp C_NEXT XXX ,
//├──────────┼──────────┼──────────┼──────────┼──────────┼──────────┤ ├──────────┼──────────┼──────────┼──────────┼──────────┼──────────┤
    XXX        XXX        &kp RALT   &u_to_U_FUN &u_to_U_MEDIA XXX  ,   &u_out_tog &u_bt_sel_0 &u_bt_sel_1 &u_bt_sel_2 &u_bt_sel_3 XXX   ,
//╰──────────┴──────────┴──────────┼──────────┼──────────┼──────────┤ ├──────────┼──────────┼──────────┼──────────┴──────────┴──────────╯
                                     XXX        XXX        XXX      ,   &kp C_STOP &kp C_PP   &kp C_MUTE
//                                 ╰──────────┴──────────┴──────────╯ ╰──────────┴──────────┴──────────╯
)

ZMK_BASE_LAYER(Num,
//╭──────────┬──────────┬──────────┬──────────┬──────────┬──────────╮ ╭──────────┬──────────┬──────────┬──────────┬──────────┬──────────╮
    XXX        &kp LBKT   &kp N7     &kp N8     &kp N9     &kp RBKT ,   XXX        &u_to_U_BASE &u_to_U_EXTRA &u_to_U_TAP &bootloader XXX    ,
//├──────────┼──────────┼──────────┼──────────┼──────────┼──────────┤ ├──────────┼──────────┼──────────┼──────────┼──────────┼──────────┤
    XXX        &kp PLUS   &kp N4     &kp N5     &kp N6     &kp EQUAL,   XXX        &kp LSHFT  &kp LCTRL  &kp LGUI   &kp LALT   XXX      ,
//├──────────┼──────────┼──────────┼──────────┼──────────┼──────────┤ ├──────────┼──────────┼──────────┼──────────┼──────────┼──────────┤
    XXX        &kp GRAVE  &kp N1     &kp N2     &kp N3     &kp BSLH ,   XXX        &u_to_U_NUM &u_to_U_NAV &kp RALT   XXX        XXX      ,
//╰──────────┴──────────┴──────────┼──────────┼──────────┼──────────┤ ├──────────┼──────────┼──────────┼──────────┴──────────┴──────────╯
                                     &kp DOT    &kp N0     &kp MINUS,   XXX        XXX        XXX
//                                 ╰──────────┴──────────┴──────────╯ ╰──────────┴──────────┴──────────╯
)

ZMK_BASE_LAYER(Sym,
//╭──────────┬──────────┬──────────┬──────────┬──────────┬──────────╮ ╭──────────┬──────────┬──────────┬──────────┬──────────┬──────────╮
    XXX        &kp LBRC   &kp AMPS   &kp ASTRK  &kp LPAR   &kp RBRC ,   XXX        &u_to_U_BASE &u_to_U_EXTRA &u_to_U_TAP &bootloader XXX    ,
//├──────────┼──────────┼──────────┼──────────┼──────────┼──────────┤ ├──────────┼──────────┼──────────┼──────────┼──────────┼──────────┤
    XXX        &kp LT     &kp DLLR   &kp PRCNT  &kp CARET  &kp GT   ,   XXX        &kp LSHFT  &kp LCTRL  &kp LGUI   &kp LALT   XXX      ,
//├──────────┼──────────┼──────────┼──────────┼──────────┼──────────┤ ├──────────┼──────────┼──────────┼──────────┼──────────┼──────────┤
    XXX        &kp TILDE  &kp EXCL   &kp AT     &kp HASH   &kp PIPE ,   XXX        &u_to_U_SYM &u_to_U_MOUSE &kp RALT   XXX        XXX      ,
//╰──────────┴──────────┴──────────┼──────────┼──────────┼──────────┤ ├──────────┼──────────┼──────────┼──────────┴──────────┴──────────╯
                                     &kp LPAR   &kp RPAR   &kp UNDER,   XXX        XXX        XXX
//                                 ╰──────────┴──────────┴──────────╯ ╰──────────┴──────────┴──────────╯
)

ZMK_BASE_LAYER(Fun,
//╭──────────┬──────────┬──────────┬──────────┬──────────┬──────────╮ ╭──────────┬──────────┬──────────┬──────────┬──────────┬──────────╮
    &studio_unlock &kp F12    &kp F7     &kp F8     &kp F9     &kp PSCRN,   XXX        &u_to_U_BASE &u_to_U_EXTRA &u_to_U_TAP &bootloader XXX    ,
//├──────────┼──────────┼──────────┼──────────┼──────────┼──────────┤ ├──────────┼──────────┼──────────┼──────────┼──────────┼──────────┤
    XXX        &kp F11    &kp F4     &kp F5     &kp F6     &kp SLCK ,   XXX        &kp LSHFT  &kp LCTRL  &kp LGUI   &kp LALT   XXX      ,
//├──────────┼──────────┼──────────┼──────────┼──────────┼──────────┤ ├──────────┼──────────┼──────────┼──────────┼──────────┼──────────┤
    XXX        &kp F10    &kp F1     &kp F2     &kp F3     &kp PAUSE_BREAK , XXX        &u_to_U_FUN &u_to_U_MEDIA &kp RALT   XXX        XXX      ,
//╰──────────┴──────────┴──────────┼──────────┼──────────┼──────────┤ ├──────────┼──────────┼──────────┼──────────┴──────────┴──────────╯
                                     &kp K_APP  &kp SPACE  &kp TAB  ,   XXX        XXX        XXX
//                                 ╰──────────┴──────────┴──────────╯ ╰──────────┴──────────┴──────────╯
)

/ {
    macros {
        u_macro_u_bt_sel_0: u_macro_u_bt_sel_0 {
            compatible = "zmk,behavior-macro";
            #binding-cells = <0>;
            wait-ms = <0>;
            bindings = <&bt BT_SEL 0 &bt BT_CLR>;
        };
    };
};

/ {
    behaviors {
        u_bt_sel_0: u_bt_sel_0 {
            compatible = "zmk,behavior-mod-morph";
            #binding-cells = <0>;
            bindings = <&bt BT_SEL 0>, <&u_macro_u_bt_sel_0>;

            mods = <(MOD_LSFT|MOD_RSFT)>;
        };
    };
};

/ {
    macros {
        u_macro_u_bt_sel_1: u_macro_u_bt_sel_1 {
            compatible = "zmk,behavior-macro";
            #binding-cells = <0>;
            wait-ms = <0>;
            bindings = <&bt BT_SEL 1 &bt BT_CLR>;
        };
    };
};

/ {
    behaviors {
        u_bt_sel_1: u_bt_sel_1 {
            compatible = "zmk,behavior-mod-morph";
            #binding-cells = <0>;
            bindings = <&bt BT_SEL 1>, <&u_macro_u_bt_sel_1>;

            mods = <(MOD_LSFT|MOD_RSFT)>;
        };
    };
};

/ {
    macros {
        u_macro_u_bt_sel_2: u_macro_u_bt_sel_2 {
            compatible = "zmk,behavior-macro";
            #binding-cells = <0>;
            wait-ms = <0>;
            bindings = <&bt BT_SEL 2 &bt BT_CLR>;
        };
    };
};

/ {
    behaviors {
        u_bt_sel_2: u_bt_sel_2 {
            compatible = "zmk,behavior-mod-morph";
            #binding-cells = <0>;
            bindings = <&bt BT_SEL 2>, <&u_macro_u_bt_sel_2>;

            mods = <(MOD_LSFT|MOD_RSFT)>;
        };
    };
};

/ {
    macros {
        u_macro_u_bt_sel_3: u_macro_u_bt_sel_3 {
            compatible = "zmk,behavior-macro";
            #binding-cells = <0>;
            wait-ms = <0>;
            bindings = <&bt BT_SEL 3 &bt BT_CLR>;
        };
    };
};

/ {
    behaviors {
        u_bt_sel_3: u_bt_sel_3 {
            compatible = "zmk,behavior-mod-morph";
            #binding-cells = <0>;
            bindings = <&bt BT_SEL 3>, <&u_macro_u_bt_sel_3>;

            mods = <(MOD_LSFT|MOD_RSFT)>;
        };
    };
};

/ {
    macros {
        u_macro_u_bt_sel_4: u_macro_u_bt_sel_4 {
            compatible = "zmk,behavior-macro";
            #binding-cells = <0>;
            wait-ms = <0>;
            bindings = <&bt BT_SEL 4 &bt BT_CLR>;
        };
    };
};

/ {
    behaviors {
        u_bt_sel_4: u_bt_sel_4 {
            compatible = "zmk,behavior-mod-morph";
            #binding-cells = <0>;
            bindings = <&bt BT_SEL 4>, <&u_macro_u_bt_sel_4>;

            mods = <(MOD_LSFT|MOD_RSFT)>;
        };
    };
};

/ {
    behaviors {
        u_out_tog: u_out_tog {
            compatible = "zmk,behavior-mod-morph";
            #binding-cells = <0>;
            bindings = <&out OUT_TOG>, <&out OUT_USB>;

            mods = <(MOD_LSFT|MOD_RSFT)>;
        };
    };
};

/ {
    behaviors {
        u_caps_word: u_caps_word {
            compatible = "zmk,behavior-mod-morph";
            #binding-cells = <0>;
            bindings = <&caps_word>, <&kp CAPS>;

            mods = <(MOD_LSFT|MOD_RSFT)>;
        };
    };
};

/ {
    behaviors {
        u_to_U_BASE: u_to_U_BASE {
            compatible = "zmk,behavior-tap-dance";
            #binding-cells = <0>;
            tapping-term-ms = <200>;
            bindings = <&none>, <&to 0>;
        };
    };
};

/ {
    behaviors {
        u_to_U_EXTRA: u_to_U_EXTRA {
            compatible = "zmk,behavior-tap-dance";
            #binding-cells = <0>;
            tapping-term-ms = <200>;
            bindings = <&none>, <&to 1>;
        };
    };
};

/ {
    behaviors {
        u_to_U_TAP: u_to_U_TAP {
            compatible = "zmk,behavior-tap-dance";
            #binding-cells = <0>;
            tapping-term-ms = <200>;
            bindings = <&none>, <&to 2>;
        };
    };
};

/ {
    behaviors {
        u_to_U_BUTTON: u_to_U_BUTTON {
            compatible = "zmk,behavior-tap-dance";
            #binding-cells = <0>;
            tapping-term-ms = <200>;
            bindings = <&none>, <&to 3>;
        };
    };
};

/ {
    behaviors {
        u_to_U_NAV: u_to_U_NAV {
            compatible = "zmk,behavior-tap-dance";
            #binding-cells = <0>;
            tapping-term-ms = <200>;
            bindings = <&none>, <&to 4>;
        };
    };
};

/ {
    behaviors {
        u_to_U_MOUSE: u_to_U_MOUSE {
            compatible = "zmk,behavior-tap-dance";
            #binding-cells = <0>;
            tapping-term-ms = <200>;
            bindings = <&none>, <&to 5>;
        };
    };
};

/ {
    behaviors {
        u_to_U_MEDIA: u_to_U_MEDIA {
            compatible = "zmk,behavior-tap-dance";
            #binding-cells = <0>;
            tapping-term-ms = <200>;
            bindings = <&none>, <&to 6>;
        };
    };
};

/ {
    behaviors {
        u_to_U_NUM: u_to_U_NUM {
            compatible = "zmk,behavior-tap-dance";
            #binding-cells = <0>;
            tapping-term-ms = <200>;
            bindings = <&none>, <&to 7>;
        };
    };
};

/ {
    behaviors {
        u_to_U_SYM: u_to_U_SYM {
            compatible = "zmk,behavior-tap-dance";
            #binding-cells = <0>;
            tapping-term-ms = <200>;
            bindings = <&none>, <&to 8>;
        };
    };
};

/ {
    behaviors {
        u_to_U_FUN: u_to_U_FUN {
            compatible = "zmk,behavior-tap-dance";
            #binding-cells = <0>;
            tapping-term-ms = <200>;
            bindings = <&none>, <&to 9>;
        };
    };
};

/ {
    macros {
        u_macro_btn1: u_macro_btn1 {
            compatible = "zmk,behavior-macro";
            #binding-cells = <0>;
            wait-ms = <0>;
            bindings = <&kp KP_SLASH &kp KP_N5>;
        };
    };
};

/ {
    macros {
        u_macro_btn2: u_macro_btn2 {
            compatible = "zmk,behavior-macro";
            #binding-cells = <0>;
            wait-ms = <0>;
            bindings = <&kp KP_MINUS &kp KP_N5>;
        };
    };
};

/ {
    macros {
        u_macro_btn3: u_macro_btn3 {
            compatible = "zmk,behavior-macro";
            #binding-cells = <0>;
            wait-ms = <0>;
            bindings = <&kp KP_ASTERISK &kp KP_N5>;
        };
    };
};

/ {
    behaviors {
        u_mt: u_mt {
            compatible = "zmk,behavior-hold-tap";
            #binding-cells = <2>;
            tapping-term-ms = <200>;
            flavor = "tap-preferred";
            bindings = <&kp>, <&kp>;
        };

        u_lt: u_lt {
            compatible = "zmk,behavior-hold-tap";
            #binding-cells = <2>;
            tapping-term-ms = <200>;
            flavor = "tap-preferred";
            bindings = <&mo>, <&kp>;
        };
    };
};
