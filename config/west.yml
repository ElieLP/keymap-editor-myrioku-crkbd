## config/west.yml
```yaml
manifest:
  remotes:
    - name: zmkfirmware
      url-base: https://github.com/zmkfirmware
    - name: urob
      url-base: https://github.com/urob
  projects:
    - name: zmk
      remote: zmkfirmware
      revision: main
      import: app/west.yml
    - name: zmk-helpers
      remote: urob
      revision: main
      path: modules/zmk/helpers
    - name: zmk-unicode
      path: modules/zmk/unicode
    - name: zmk-leader-key
      path: modules/zmk/leader-key
  self:
    path: config
```
